/**
 * @cliArgs --board "/ti/boards/CC1352R1_LAUNCHXL" --device "CC1352R1F3RGZ" --part "Default" --package "RGZ" --rtos "tirtos7" --product "simplelink_cc13xx_cc26xx_sdk@8.32.00.07"
 * @versions {"tool":"1.21.1+3772"}
 */

/**
 * Import the modules used in this configuration.
 */
const CCFG        = scripting.addModule("/ti/devices/CCFG");
const custom      = scripting.addModule("/ti/devices/radioconfig/custom");
const rfdesign    = scripting.addModule("/ti/devices/radioconfig/rfdesign");
const GPIO        = scripting.addModule("/ti/drivers/GPIO");
const GPIO1       = GPIO.addInstance();
const RF          = scripting.addModule("/ti/drivers/RF");
const UART2       = scripting.addModule("/ti/drivers/UART2", {}, false);
const UART21      = UART2.addInstance();
const Settings    = scripting.addModule("/ti/posix/tirtos/Settings");
const BIOS        = scripting.addModule("/ti/sysbios/BIOS");
const Event       = scripting.addModule("/ti/sysbios/knl/Event");
const Idle        = scripting.addModule("/ti/sysbios/knl/Idle", {}, false);
const Idle2       = Idle.addInstance();
const Mailbox     = scripting.addModule("/ti/sysbios/knl/Mailbox");
const Error       = scripting.addModule("/ti/sysbios/runtime/Error");
const SysCallback = scripting.addModule("/ti/sysbios/runtime/SysCallback");
const Timestamp   = scripting.addModule("/ti/sysbios/runtime/Timestamp");

/**
 * Write custom configuration values to the imported modules.
 */
CCFG.enableBootloader        = true;
CCFG.dioBootloaderBackdoor   = 15;
CCFG.levelBootloaderBackdoor = "Active low";
CCFG.forceVddr               = true;
CCFG.ccfgTemplate.$name      = "ti_devices_CCFG_CCFGCC26XXTemplate0";

custom.prop8                                       = ["custom868"];
custom.radioConfigcustom868.$name                  = "ti_devices_radioconfig_settings_prop0";
custom.radioConfigcustom868.packetLengthConfig     = "Fixed";
custom.radioConfigcustom868.fixedPacketLength      = 200;
custom.radioConfigcustom868.phyType868             = "2gfsk500kbps154g";
custom.radioConfigcustom868.carrierFrequency       = 923.0000;
custom.radioConfigcustom868.codeExportConfig.$name = "ti_devices_radioconfig_code_export_param0";

GPIO1.$hardware = system.deviceData.board.components.LED_RED;
GPIO1.$name     = "CONFIG_GPIO_RLED";

RF.interruptPriority         = "1";
RF.softwareInterruptPriority = "1";

UART21.$name              = "CONFIG_UART2_0";
UART21.$hardware          = system.deviceData.board.components.XDS110UART;
UART21.rxRingBufferSize   = 4096;
UART21.enableNonblocking  = false;
UART21.rxPinInstance.pull = "None";

BIOS.assertsEnabled = false;
BIOS.heapBaseAddr   = "__primary_heap_start__";
BIOS.heapEndAddr    = "__primary_heap_end__";

const Clock      = scripting.addModule("/ti/sysbios/knl/Clock", {}, false);
Clock.tickPeriod = 10;

const Timer = scripting.addModule("/ti/sysbios/family/arm/cc26xx/Timer", {}, false);

Idle2.$name   = "powerIdle";
Idle2.idleFxn = "Power_idleFunc";

const Semaphore            = scripting.addModule("/ti/sysbios/knl/Semaphore", {}, false);
Semaphore.supportsPriority = false;

const Swi         = scripting.addModule("/ti/sysbios/knl/Swi", {}, false);
Swi.numPriorities = 6;

const Task             = scripting.addModule("/ti/sysbios/knl/Task", {}, false);
Task.checkStackFlag    = false;
Task.defaultStackSize  = 512;
Task.idleTaskStackSize = 512;
Task.numPriorities     = 6;

Error.policy       = "Error_SPIN";
Error.printDetails = false;

const System           = scripting.addModule("/ti/sysbios/runtime/System", {}, false);
System.abortFxn        = "System_abortSpin";
System.exitFxn         = "System_exitSpin";
System.extendedFormats = "%f";
System.supportModule   = "SysCallback";

/**
 * Pinmux solution for unlocked pins/peripherals. This ensures that minor changes to the automatic solver in a future
 * version of the tool will not impact the pinmux you originally saw.  These lines can be completely deleted in order to
 * re-solve from scratch.
 */
GPIO1.gpioPin.$suggestSolution     = "boosterpack.39";
UART21.uart.$suggestSolution       = "UART0";
UART21.uart.txPin.$suggestSolution = "boosterpack.4";
UART21.uart.rxPin.$suggestSolution = "boosterpack.3";
Timer.rtc.$suggestSolution         = "RTC0";
